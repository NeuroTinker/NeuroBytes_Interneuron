#include "pins.h"

static pin_t * all_pins[NUM_PINS];
static pin_group_t * output_pins;
static pin__group_t * input_pins;

void initPins(void)
{
	// generated by pin-map.py config using pin-map.json

	// axon 1 excit A8
	all_pins[0]->address = initPinAddress(PORT_AXON1_EX, PIN_AXON1_EX);
	all_pins[0]->pin_type = EXCIT;
	all_pins[0]->port_type = AXON;
	all_pins[0]->complimentary_pin_ptr = all_pins[1];
	all_pins[0]->exti = PIN_AXON1_EX;
	setPinAsOutput(all_pins[0]);

	// axon 1 inhib B0
	all_pins[1]->address = initPinAddress(PORT_AXON1_IN, PIN_AXON1_IN);
	all_pins[1]->pin_type = INHIB;
	all_pins[1]->port_type = AXON;
	all_pins[1]->complimentary_pin_ptr = all_pins[0];
	all_pins[1]->exti = PIN_AXON1_IN;
	setPinAsInput(all_pins[1]);

	// dendrite 1 excit B1
	all_pins[2]->address = initPinAddress(PORT_DEND1_EX, PIN_DEND1_EX);
	all_pins[2]->pin_type = EXCIT;
	all_pins[2]->port_type = DEND;
	all_pins[2]->complimentary_pin_ptr = all_pins[3];
	all_pins[2]->exti = PIN_DEND1_EX;
	setPinAsInput(all_pins[1]);

	// dendrite 1 inhib B15
	all_pins[3]->address = initPinAddress(PORT_DEND1_IN, PIN_DEND1_IN);
	all_pins[3]->pin_type = INHIB;
	all_pins[3]->port_type = DEND;
	all_pins[3]->complimentary_pin_ptr = all_pins[2];
	all_pins[3]->exti = PIN_DEND1_IN;
	setPinAsInput(all_pins[3]);
}

static pin_address_t * initPinAddress(uint32_t port, uint32_t pin)
{
    pin_address_t * address = malloc(sizeof(pin_address_t));
    pin_address_t address_init = {port, pin};
    memset(address, &address_init, sizeof(pin_address_t));
    return address;
}

static input_buffer_t * initInputBuffer(void)
{
    input_buffer_t * buffer = calloc(sizeof(input_buffer_t));
    input_buffer_t buffer_init = {0, 0, 0, MESSAGE};
    memset(buffer, &buffer_init, sizeof(input_buffer_t));
    return buffer;
}

static void freeInputBuffer(pin_t * pin)
{
    free(pin_t->input_buffer);
}

void startRead(pin_t * pin, uint8_t read_tick)
{
    pin->input_buffer = initInputBuffer();
    pin->input_buffer->read_tick = (read_tick + 1) % 3;
    pin->input_buffer->num_bits_to_read = 8;
    input_pins->num_pins += 1;
    if (input_pins->num_pins == 1){
        input_pins->pins = malloc(sizeof(pin_t *));
        input_pins->pins[0] = pin;
    } else{
        input_pins->pins = realloc(input_pins->pins, sizeof(pin_t *) * input_pins->num_pins);
        input_pins->pins[input_pins->num_pins - 1] = pin;
    }
}

void endRead(pin_t * pin)
{
    uint8_t i;
    bool shift_flag = false;

    for (i=0; i < input_pins->num_pins - 1; i++){
        if (input_pins->pins[i] == pin){
            shift_flag = true;
        }
        if (shift_flag){
            input_pins->pins[i] = input_pins[i+1];
        }
    }

    input_pins->num_pins -= 1;
    realloc(input_pins->pins, sizeof(pin_t *) * input_pins->num_pins);
}

pin_group_t getInputPins(void)
{
    return input_pins;
}

void selectOutputPins(pin_group_name_t output_group_name)
{
    uint8_t i;

    switch(output_group_name){
        case ALL:
            output_pins->num_pins = 0;
            for (i=0; i<NUM_PINS; i++){
                if (all_pins[i]->io_state == OUTPUT && all_pins[i] != nid_pin){
                    output_pins->num_pins += 1;
                    realloc(output_pins->pins, sizeof(pin_t *) * output_pins->num_pins);
                    output_pins->pins[output_pins->num_pins - 1] = all_pins[i];
                }
            }
            break;
        case NID:
            output_pins->num_pins = 1;
            realloc(output_pins->pins, sizeof(pin_t *));
            memcpy(output_pins->pins, nid_pin);
            break;
        case AXONS:
            ouput_pins->num_pins = NUM_AXONS;
            realloc(output_pins->pins, sizeof(pin_t *) * output_pins->num_pins);
            memcpy(output_pins->pins, axon_output_pins);
            break;
    }
}

/*
	Each input's ISR tells the communications program that the input is active (getting a message) by setting active_output_pins[i].
*/

void exti0_1_isr(void)
{
	if ((EXTI_PR & EXTI0) != 0){
		startRead(DEND1_IN, 8);
	} else if ((EXTI_PR & EXTI1) != 0){
		startRead(DEND1_IN, 8);
	}
}

void exti4_15_isr(void)
{
	if ((EXTI_PR & PIN_AXON1_IN) != 0){
		startRead(AXON1_IN, 8);
	}
}